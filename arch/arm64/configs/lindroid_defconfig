## arch/arm64/configs/lindroid_defconfig
```kconfig
CONFIG_ANDROID=y

CONFIG_ANDROID_BINDER_IPC=y

CONFIG_ANDROID_BINDERFS=y

CONFIG_ANDROID_BINDER_DEVICES="binder,hwbinder,vndbinder"

CONFIG_ASHMEM=y

CONFIG_ION=y

CONFIG_NAMESPACES=y

CONFIG_UTS_NS=y

CONFIG_IPC_NS=y

CONFIG_USER_NS=y

CONFIG_PID_NS=y

CONFIG_NET_NS=y

CONFIG_CGROUPS=y

CONFIG_CGROUP_FREEZER=y

CONFIG_CGROUP_DEVICE=y

CONFIG_CGROUP_CPUACCT=y

CONFIG_CGROUP_SCHED=y

CONFIG_CFS_BANDWIDTH=y

CONFIG_FAIR_GROUP_SCHED=y

CONFIG_RT_GROUP_SCHED=y

CONFIG_CGROUP_PIDS=y

CONFIG_CGROUP_RDMA=y

CONFIG_CGROUP_BPF=y

CONFIG_MEMCG=y

CONFIG_MEMCG_SWAP=y

CONFIG_MEMCG_SWAP_ENABLED=y

CONFIG_BLK_CGROUP=y

CONFIG_CGROUP_WRITEBACK=y

CONFIG_CGROUP_PERF=y

CONFIG_CPUSETS=y

CONFIG_PROC_PID_CPUSET=y

CONFIG_OVERLAY_FS=y

CONFIG_OVERLAY_FS_REDIRECT_DIR=y

CONFIG_OVERLAY_FS_INDEX=y

CONFIG_OVERLAY_FS_METACOPY=y

CONFIG_EXT4_FS=y

CONFIG_EXT4_FS_POSIX_ACL=y

CONFIG_EXT4_FS_SECURITY=y

CONFIG_FUSE_FS=y

CONFIG_CUSE=y

CONFIG_VFAT_FS=y

CONFIG_TMPFS=y

CONFIG_TMPFS_POSIX_ACL=y

CONFIG_TMPFS_XATTR=y

CONFIG_INPUT_EVDEV=y

CONFIG_INPUT_UINPUT=y

CONFIG_HID_MULTITOUCH=y

CONFIG_USB_HIDDEV=y

CONFIG_KALLSYMS=y

CONFIG_KALLSYMS_ALL=y

CONFIG_DEBUG_FS=y

CONFIG_PROC_FS=y

CONFIG_SYSFS=y

CONFIG_STRICT_DEVMEM=y

CONFIG_DEVTMPFS=y

CONFIG_DEVTMPFS_MOUNT=y

CONFIG_PACKET=y

CONFIG_UNIX=y

CONFIG_INET=y

CONFIG_IPV6=y

CONFIG_NETFILTER=y

CONFIG_NETFILTER_ADVANCED=y

CONFIG_BRIDGE=y

CONFIG_VETH=y

CONFIG_TUN=y

CONFIG_MACVLAN=y

CONFIG_DUMMY=y
```
